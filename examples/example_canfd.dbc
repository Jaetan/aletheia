VERSION ""

NS_ :

BS_:

BU_: ECU_SENSOR ECU_BRAKE

BO_ 256 EngineStatus: 8 ECU_SENSOR
 SG_ EngineSpeed : 0|16@1+ (0.25,0) [0|8000] "rpm" Vector__XXX
 SG_ EngineTemp : 16|8@1+ (1,-40) [-40|215] "celsius" Vector__XXX

BO_ 512 SensorFusion: 64 ECU_SENSOR
 SG_ GPSLatitude : 0|32@1- (0.0000001,0) [-90|90] "deg" Vector__XXX
 SG_ GPSLongitude : 32|32@1- (0.0000001,0) [-180|180] "deg" Vector__XXX
 SG_ GPSAltitude : 64|16@1- (0.1,0) [-1000|3276.7] "m" Vector__XXX
 SG_ GPSSpeed : 80|16@1+ (0.01,0) [0|655.35] "m/s" Vector__XXX
 SG_ YawRate : 96|16@1- (0.01,0) [-327.68|327.67] "deg/s" Vector__XXX
 SG_ LateralAccel : 112|16@1- (0.01,0) [-327.68|327.67] "m/s2" Vector__XXX
 SG_ LongAccel : 128|16@1- (0.01,0) [-327.68|327.67] "m/s2" Vector__XXX
 SG_ SteeringAngle : 144|16@1- (0.1,0) [-3276.8|3276.7] "deg" Vector__XXX
 SG_ WheelSpeedFL : 160|16@1+ (0.01,0) [0|655.35] "m/s" Vector__XXX
 SG_ WheelSpeedFR : 176|16@1+ (0.01,0) [0|655.35] "m/s" Vector__XXX
 SG_ WheelSpeedRL : 192|16@1+ (0.01,0) [0|655.35] "m/s" Vector__XXX
 SG_ WheelSpeedRR : 208|16@1+ (0.01,0) [0|655.35] "m/s" Vector__XXX
 SG_ BrakeTempFL : 224|12@1+ (0.1,0) [0|409.5] "celsius" Vector__XXX
 SG_ BrakeTempFR : 236|12@1+ (0.1,0) [0|409.5] "celsius" Vector__XXX
 SG_ BrakeTempRL : 248|12@1+ (0.1,0) [0|409.5] "celsius" Vector__XXX
 SG_ BrakeTempRR : 260|12@1+ (0.1,0) [0|409.5] "celsius" Vector__XXX
 SG_ TirePressFL : 272|8@1+ (0.01,0) [0|2.55] "bar" Vector__XXX
 SG_ TirePressFR : 280|8@1+ (0.01,0) [0|2.55] "bar" Vector__XXX
 SG_ TirePressRL : 288|8@1+ (0.01,0) [0|2.55] "bar" Vector__XXX
 SG_ TirePressRR : 296|8@1+ (0.01,0) [0|2.55] "bar" Vector__XXX
 SG_ SensorStatus : 304|8@1+ (1,0) [0|255] "" Vector__XXX
 SG_ IMUTemp : 312|8@1+ (1,-40) [-40|215] "celsius" Vector__XXX
 SG_ BatteryVolt : 320|12@1+ (0.01,0) [0|40.95] "V" Vector__XXX
 SG_ GPSHeading : 332|16@1+ (0.01,0) [0|655.35] "deg" Vector__XXX
 SG_ TimestampMs : 348|32@1+ (1,0) [0|4294967295] "ms" Vector__XXX

BO_ 768 BrakeStatus: 8 ECU_BRAKE
 SG_ BrakePressure : 0|16@1+ (0.1,0) [0|6553.5] "bar" Vector__XXX
 SG_ BrakePressed : 16|1@1+ (1,0) [0|1] "" Vector__XXX
