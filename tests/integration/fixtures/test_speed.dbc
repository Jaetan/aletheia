VERSION ""

NS_ :

BS_:

BU_: ECU

BO_ 256 SpeedMessage: 8 ECU
 SG_ Speed : 0|16@1+ (0.1,0) [0|300] "km/h" Vector__XXX
