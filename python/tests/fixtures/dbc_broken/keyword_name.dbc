VERSION ""

NS_ :

BS_:

BU_: N

BO_ 1 M: 8 N
 SG_ BO_ : 0|8@1+ (1,0) [0|1] "u" N
