VERSION "net-1"

NS_ :

BS_:

BU_: Alpha Beta

BO_ 500 TelemetryA: 8 Alpha
 SG_ Voltage : 0|32@1+ (0.001,0) [0|4294967.295] "V" Beta
 SG_ Current : 32|32@1- (0.001,0) [-2147483.648|2147483.647] "A" Beta

BO_ 501 TelemetryB: 8 Beta
 SG_ GyroX : 0|32@1- (0.00001,0) [-21474.83648|21474.83647] "rad/s" Alpha
 SG_ GyroY : 32|32@1- (0.00001,0) [-21474.83648|21474.83647] "rad/s" Alpha

EV_ TestRigMode: 0 [0|2] "" 0 1 DUMMY_NODE_VECTOR0 Vector__XXX;

CM_ "Top-level network description.";
CM_ BU_ Alpha "Primary data producer.";
CM_ BO_ 500 "Voltage/current telemetry from Alpha.";
CM_ SG_ 501 GyroX "Body-frame angular rate about the X axis.";
CM_ EV_ TestRigMode "Rig mode: 0=idle, 1=run, 2=fault.";

SIG_GROUP_ 500 Electrical 1 : Voltage Current;
SIG_GROUP_ 501 IMURates 1 : GyroX GyroY;

SIG_VALTYPE_ 500 Voltage : 1;
SIG_VALTYPE_ 500 Current : 1;
SIG_VALTYPE_ 501 GyroX : 2;
SIG_VALTYPE_ 501 GyroY : 2;
