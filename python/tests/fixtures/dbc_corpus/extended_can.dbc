VERSION ""

NS_ :

BS_:

BU_: ECU

BO_ 256 Std: 8 ECU
 SG_ PayloadStd : 0|16@1+ (1,0) [0|65535] "" Vector__XXX

BO_ 2147483904 Ext: 8 ECU
 SG_ PayloadExt : 0|16@1+ (1,0) [0|65535] "" Vector__XXX

BO_ 512 StdFD: 16 ECU
 SG_ PayloadFD : 0|32@1+ (1,0) [0|4294967295] "" Vector__XXX

BO_ 2147483905 ExtFD: 64 ECU
 SG_ PayloadExtFD : 0|32@1+ (1,0) [0|4294967295] "" Vector__XXX

BA_DEF_ BO_  "VFrameFormat" ENUM  "StandardCAN","ExtendedCAN","reserved","reserved","StandardCAN_FD","ExtendedCAN_FD";
BA_DEF_ "BusType" STRING ;
BA_DEF_DEF_  "VFrameFormat" "StandardCAN";
BA_DEF_DEF_  "BusType" "";
BA_ "BusType" "CAN FD";
BA_ "VFrameFormat" BO_ 2147483904 1;
BA_ "VFrameFormat" BO_ 512 4;
BA_ "VFrameFormat" BO_ 2147483905 5;
